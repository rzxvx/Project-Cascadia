## devices/a5/patches/files/drivers/mtd/nand/apple/Kconfig
```kconfig
# SPDX-License-Identifier: GPL-2.0-only
config APPLE_PPN
	tristate "Apple A5 PPN NAND controller (PIO)"
	depends on ARCH_APPLE_S5L || COMPILE_TEST
	help
	  The FMI/FMC controller of the Apple A5 and its PPN NAND package,
	  driven by PIO.  Only the package on the iPad mini 1 (P105) is
	  supported.  Program and erase need the allow_write parameter.

config APPLE_SFTL
	tristate "Swiss FTL block devices on the Apple PPN NAND"
	depends on APPLE_PPN && BLOCK
	help
	  Exposes the iOS Swiss FTL and its LwVM volumes as block devices.
	  Read-only unless enable_write and write_volume are set.

config APPLE_SFTL_WRITE
	bool "Program, erase and the FTL writer"
	depends on APPLE_SFTL
	default y
	help
	  Builds the program and erase sequences and the FTL write path.
	  Without it nothing in either driver can change the NAND.  With it,
	  writing still needs apple_ppn.allow_write, apple_ftl.enable_write
	  and apple_ftl.write_volume on the command line.

config APPLE_PPN_FAULT_INJECT
	bool "Test-only program and erase failure injection"
	depends on APPLE_SFTL_WRITE
	default n
	help
	  Adds apple_ppn parameters (inject_program, inject_mode,
	  inject_erase) that make a program or an erase look failed, for
	  testing the FTL's bad-block handling.  Say N.
```
