## Cascadia/A5/iPad Mini 1/Kernel/mach-apple5/Kconfig
```kconfig
config ARCH_APPLE_S5L8942X
	bool "Apple S5L8942X (A5) based platforms"
	depends on ARCH_MULTI_V7
	select CPU_V7
	select HAVE_ARM_SCU if SMP
	select ARM_GIC
	help
	  Support for Apple A5 (S5L8942X) based devices,
	  such as the iPad mini 1 (iPad2,5).

	
```

## devices/a5/patches/files/drivers/media/platform/apple/Kconfig
```kconfig
# SPDX-License-Identifier: GPL-2.0-only

comment "Apple media platform drivers"

config VIDEO_APPLE_H4ISP
	tristate "Apple A5 H4 camera ISP (the iPad 2's cameras)"
	depends on V4L_PLATFORM_DRIVERS
	depends on VIDEO_DEV
	depends on ARCH_APPLE_S5L || COMPILE_TEST
	depends on HAS_DMA && OF && COMMON_CLK
	select VIDEOBUF2_DMA_SG
	select GENERIC_ALLOCATOR
	help
	  The camera ISP of the Apple A5 (S5L8940X): a CPU of its own that
	  runs Apple's firmware behind an IOMMU, drives the iPad 2's rear
	  and front cameras and writes YUYV frames.  Two V4L2 capture
	  devices, one a camera.  Needs apple/h4isp-firmware.bin and the
	  sensors' set-files from iOS.
```

## experiments/p105-current/Kconfig
```kconfig
config APPLE_D1946_CURRENT_EXPERIMENTAL
	tristate "Experimental P105 inherited-state current controller"
	depends on OF && REGMAP && POWER_SUPPLY && IRQ_DOMAIN
	default n
	help
	  Private unvalidated prototype. No default DT node or enabling path.
	  Requires a verified inherited analog protection configuration, authoritative
	  coherent source/gauge provider and explicit runtime experiment parameters.
	  Does not configure CV, termination, watchdog or OTP. Not hardware tested.
```

## experiments/p105-native-clock/Kconfig.fragment
```kconfig
config CASCADIA_EXPERIMENTAL_NATIVE_CLOCK
	bool "Source-only P105 native host clock broker experiment"
	depends on ARM && REGMAP
	default n
	help
	  Compile checked P105 12H321 host87/89 clock graph primitives only.
	  No clock provider, platform probe, DT binding or role is registered.
	  Activation requires externally proven adoption of every global owner,
	  inherited references, physical state and power policy. Those bindings
	  are unresolved; this experiment supplies no activation path.
```

## experiments/p105-parent-pmu/Kconfig.fragment
```kconfig
config APPLE_PMU_D1946_BANK0_EXPERIMENT
	bool "Experimental P105 global D1946 bank0 parent transport"
	depends on MFD_APPLE_PMU_I2C=y
	depends on I2C_CHARDEV = n
	default n
	help
	  Source-only unvalidated option. Also requires explicit readonly opt-in
	  parameter; no charger activation, firmware replay or analog safety grant.
	  Requires i2c-dev disabled (including its module): its retry ioctl can
	  change the adapter policy without the transfer lock.
```

## experiments/p105-source/Kconfig
```kconfig
config P105_DWC2_SOURCE_READER
	bool "Private P105 fixed-peripheral composite source reader"
	depends on USB_DWC2=y && USB_LIBCOMPOSITE=y && P105_DWC2_POWER_OBSERVER
	default n
	help
	  USB2 completed-configuration allowance only. No external accessory grant.

config P105_COMBINED_CURRENT_PROVIDER
	tristate "Private P105 source/gauge current-provider adapter"
	depends on P105_DWC2_SOURCE_READER && POWER_SUPPLY && BATTERY_APPLE_HDQ
	default n
	help
	  API constructor only; no automatic charger binding or DT is supplied.
	  Requires the separately reviewed opaque HDQ reader implementation.
```

## experiments/p105-ths-idbus/Kconfig.fragment
```kconfig
config CASCADIA_THS_IDBUS_EXPERIMENT
	bool "Compile unregistered THS7383 IDbus primitive"
	depends on REGMAP
	default n
	help
	  Source-only experimental transport. No IRQ, device binding, lease
	  provider, authentication, power, or USB role driver is registered.
```

## experiments/p105-usb-client/Kconfig.fragment
```kconfig
config CASCADIA_EXTERNAL_USB_CLIENT_RESEARCH
 bool "Cascadia checked external USB client research component"
 depends on ARCH_APPLE_S5L && USB_EHCI_HCD
 default n
 help
   Compiles only a checked port-client lifetime component. No role switch,
   HCD, PHY, connector route or power backend is registered by this option.
```

## experiments/p105-usb-controller/Kconfig.fragment
```kconfig
config CASCADIA_USB_CONTROLLER_EXPERIMENT
	bool "Cascadia source-only P105 controller primitives"
	depends on ARCH_APPLE_S5L && REGMAP
	default n
	help
	  Denied by default, no driver registration or DT match. Requires an
	  unimplemented audited shared role/clock/PHY owner and full quiesce.
```

## experiments/p105-usb-power/Kconfig.fragment
```kconfig
config CASCADIA_P105_USB_POWER_EXPERIMENT
	bool "P105 staged PHY power primitive (source experiment)"
	depends on ARCH_APPLE_S5L && REGMAP && COMMON_CLK
	default n
	help
	  Incomplete source-only checked power stages with named clock input.
	  No DT/driver registration, owner migration, role switching, accessory
	  policy or VBUS provider exists. Keep disabled in normal and host builds.
```

## experiments/p105-usb-registers/Kconfig.fragment
```kconfig
config CASCADIA_P105_USB_REGISTER_EXPERIMENT
	bool "P105 USB register backend primitives (source experiment)"
	depends on ARCH_APPLE_S5L && REGMAP
	default n
	help
	  Incomplete source-only clock-membership and PHY-tuning primitives.
	  No driver/DT registration, connector policy, controller role switching
	  or VBUS provider exists. Keep disabled in normal and host builds.
```

## experiments/p105-usb-reset/Kconfig.fragment
```kconfig
config CASCADIA_P105_USB_RESET_EXPERIMENT
	bool "P105 standard reset ownership (source experiment)"
	depends on ARCH_APPLE_S5L && REGMAP
	default n
	help
	  Incomplete source-only checked standard reset clients. No registration,
	  native power lease provider, connector policy or VBUS driver exists.
	  Keep disabled in normal and experimental host builds.
```

## experiments/p105-usb-role/Kconfig.fragment
```kconfig
config CASCADIA_ACCESSORY_ROLE_RESEARCH
 bool "Cascadia offline-reviewed accessory role transport component"
 depends on ARCH_APPLE_S5L && USB_GADGET
 default n
 help
   Builds only a USB setup-request decoder with a deny-by-default policy.
   It registers no gadget function, role switch, PHY or power provider.
   Enabling this option alone cannot switch the connector or power VBUS.
```

## files/Documentation/devicetree/bindings/interrupt-controller/apple,aic1.yaml
```yaml
# SPDX-License-Identifier: (GPL-2.0-only OR BSD-2-Clause)
%YAML 1.2
---
$id: http://devicetree.org/schemas/interrupt-controller/apple,aic1.yaml#
$schema: http://devicetree.org/meta-schemas/core.yaml#

title: Apple Interrupt Controller revision 1 (aic,1)

description: |
  The first-generation Apple Interrupt Controller used on 32-bit S5L SoCs
  (Apple A4 through A6X).  Found at 0x3f200000 on S5L894x (iPad mini 1 /
  P105AP).

  On aic,1 (P105 lab): per-CPU EVENT is at offset 0x5004 + (cpu << 7);
  the shared 0x2004 view stays idle.  EVENT words are type<<16|num with
  HW type=1.  Do not clock-gate PMGR id 0x4D while AIC must remain live.

maintainers:
  - Apple S5L Linux port <noreply@localhost>

properties:
  compatible:
    oneOf:
      - const: aic,1
      - items:
          - const: apple,aic1
          - const: aic,1

  reg:
    maxItems: 1

  interrupt-controller: true

  "#interrupt-cells":
    const: 1
    description: Single cell is the hardware IRQ index.

  apple,main-cpus:
    $ref: /schemas/types.yaml#/definitions/uint32
    description: Number of CPU targets wired to the controller.

  use-ldrex:
    type: boolean
    description: Present in Apple ADT; driver may use LDREX/STREX for masks.

required:
  - compatible
  - reg
  - interrupt-controller
  - "#interrupt-cells"

additionalProperties: false

examples:
  - |
    soc {
        #address-cells = <1>;
        #size-cells = <1>;

        aic: interrupt-controller@f200000 {
            compatible = "aic,1";
            reg = <0xf200000 0x10000>;
            interrupt-controller;
            #interrupt-cells = <1>;
            apple,main-cpus = <2>;
        };
    };
```

## patches/files/drivers/gpu/drm/apple-sgx/Kconfig
```kconfig
# SPDX-License-Identifier: GPL-2.0-only
config DRM_APPLE_SGX
	tristate "Apple S5L8940X PowerVR SGX543MP2"
	depends on DRM
	depends on ARCH_APPLE_S5L || COMPILE_TEST
	depends on COMMON_CLK && OF
	select DRM_GEM_SHMEM_HELPER
	select DRM_SCHED
	help
	  The GPU of the Apple A5 (S5L8940X/8942X), a PowerVR SGX543MP2.
	  Switches it on with the initialisation iOS runs, starts iOS's GPU
	  microkernel (from /lib/firmware/apple/sgx543.fw, which the user
	  takes out of their own IPSW), and offers a render node for Mesa
	  and sgx2d: GEM buffers in the GPU's address space and renders
	  queued to the microkernel.  Also a 2D engine that can draw fbcon's
	  fills and copies, and research tools in debugfs (apple-sgx/).

	  The render node's interface is experimental and will change.

	  If unsure, say N.
```
